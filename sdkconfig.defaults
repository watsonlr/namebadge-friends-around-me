## sdkconfig.defaults
```kconfig
# Target configuration
CONFIG_IDF_TARGET="esp32s3"

# ESP32-S3 specific
CONFIG_ESP32S3_DEFAULT_CPU_FREQ_240=y

# Partition table
CONFIG_PARTITION_TABLE_CUSTOM=y
CONFIG_PARTITION_TABLE_CUSTOM_FILENAME="partitions.csv"
CONFIG_PARTITION_TABLE_FILENAME="partitions.csv"

# Flash size (4 MB)
CONFIG_ESPTOOLPY_FLASHSIZE_4MB=y
CONFIG_ESPTOOLPY_FLASHSIZE="4MB"

# PSRAM (Quad mode - typical for WROOM-1-N8R2/N8R8)
CONFIG_SPIRAM=y
CONFIG_SPIRAM_MODE_QUAD=y
CONFIG_SPIRAM_SPEED_80M=y
CONFIG_SPIRAM_IGNORE_NOTFOUND=y

# Bluetooth/BLE
CONFIG_BT_ENABLED=y
CONFIG_BT_BLE_ENABLED=y
CONFIG_BT_NIMBLE_ENABLED=y
CONFIG_BT_NIMBLE_ROLE_BROADCASTER=y
CONFIG_BT_NIMBLE_ROLE_OBSERVER=y
CONFIG_BT_NIMBLE_MAX_CONNECTIONS=0

# Disable classic Bluetooth
CONFIG_BT_CLASSIC_ENABLED=n

# Use legacy advertising (31-byte payload). Ext_adv would force the
# ble_gap_ext_adv_* APIs and break ble_gap_adv_set_fields/start with ENOTSUP.
# CONFIG_BT_NIMBLE_EXT_ADV is not set

# NVS
CONFIG_NVS_ENCRYPTION=n

# HTTP server for large headers (used by bootloader, may be useful)
CONFIG_HTTPD_MAX_REQ_HDR_LEN=1024

# Compiler optimization
CONFIG_COMPILER_OPTIMIZATION_SIZE=y

# Log levels
CONFIG_LOG_DEFAULT_LEVEL_INFO=y
CONFIG_LOG_MAXIMUM_LEVEL_VERBOSE=y

# Main task stack size
CONFIG_ESP_MAIN_TASK_STACK_SIZE=8192

# FreeRTOS
CONFIG_FREERTOS_HZ=1000

# Enable UART console
CONFIG_ESP_CONSOLE_UART_DEFAULT=y
CONFIG_ESP_CONSOLE_UART_NUM=0
CONFIG_ESP_CONSOLE_UART_BAUDRATE=115200

# Watchdog
CONFIG_ESP_TASK_WDT_TIMEOUT_S=10
```
